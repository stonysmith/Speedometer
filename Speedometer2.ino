#include <SPI.h>
#include <Wire.h>
#include <Adafruit_GFX.h>
#include <Adafruit_SSD1306.h>
#include <Arduino.h>

#define OLED_RESET 4
Adafruit_SSD1306 display(OLED_RESET);
#define CH_WID 16
#define CH_HEI 24
#define DP_WID 128
#define DP_HEI 32
#define DP_WID_MID 64
#define DP_HEI_MID 16

//image conversion thanks to http://javl.github.io/image2cpp/
static const unsigned char PROGMEM bnsflogo[] = {
 // 'BNSF_logo', 128x32px
0x00, 0x00, 0x00, 0x00, 0x00, 0x00, 0x00, 0x00, 0x00, 0x00, 0x3f, 0xfe, 0x00, 0x00, 0x00, 0x00, 
0x00, 0x01, 0xff, 0xff, 0xf0, 0x1f, 0xff, 0x01, 0xfe, 0x03, 0xff, 0xff, 0x80, 0x7f, 0xff, 0xf1, 
0x00, 0x01, 0xff, 0xff, 0xf8, 0x3f, 0xff, 0x83, 0xfc, 0x0f, 0xff, 0xff, 0xc0, 0xff, 0xff, 0xf0, 
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0x00, 0x00, 0x00, 0x00, 0x00, 0x00, 0x00, 0x00, 0x00, 0x00, 0x00, 0x00, 0x00, 0x00, 0x00, 0x00,};

static const unsigned char PROGMEM cokelogo[] = {
 // 'CocaCola', 128x32px
0x00, 0x00, 0x03, 0xf0, 0x00, 0x00, 0x00, 0x00, 0x00, 0x00, 0x0f, 0xcf, 0xe0, 0x00, 0x06, 0x00, 
0x00, 0x00, 0x1f, 0xf8, 0x00, 0x00, 0x00, 0x00, 0x00, 0x00, 0x7f, 0xff, 0xfc, 0x00, 0x3f, 0x03, 
0x00, 0x00, 0x7e, 0x08, 0x00, 0x00, 0x00, 0x00, 0x00, 0x01, 0xf0, 0xf0, 0xff, 0x00, 0xf2, 0x06, 
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0x03, 0xfe, 0x00, 0x00, 0x01, 0xc0, 0x0c, 0x03, 0xf0, 0x03, 0xc0, 0x0f, 0x0f, 0x1e, 0x00, 0x00,
};

// Module connection pins (Digital Pins)
#define CLK 5
#define DIO 4

#define blocked LOW
#define cleared HIGH

#define mmpermile 1609344  // (5280 * 12 * 25.4)
#define dist 50 //mm
#define scale 220
#define mshour 3600000
//#define scalemile mmpermile/scale
//#define scaledist scalemile/dist    // this is inverted - should be dist/scalemile

float scalemile = mmpermile/scale;
float scaledist = scalemile/dist;

//mph=(mshour/elapsed)/scaledist

// The amount of time (in milliseconds) between tests
#define TEST_DELAY 1000

void doMPH(int elapsed){
  float mphf=(mshour/elapsed)/scaledist;
  int mph = mphf + .5;
  //display.showNumberDec(mph, false); 
  display.clearDisplay();
  display.setCursor(0,0);
  display.setCursor(DP_WID_MID - (6 * CH_WID / 2),0);
  display.print(mph);
  display.println("mph");
  display.display();
  Serial.print("MPH=");Serial.println(mph,DEC);
  }

void setup(){
  Serial.begin(9600);
  display.begin(SSD1306_SWITCHCAPVCC, 0x3C);  // initialize with the I2C addr 0x3C (for the 128x32)
  display.clearDisplay();
  display.display();

  // Clear the buffer.
  display.clearDisplay();
  pinMode(6, INPUT);     
  pinMode(7, INPUT);
  Serial.println("Start");
  int i;
  for (i=9;i<13;i++) { 
    pinMode(i, OUTPUT);     
    digitalWrite(i, LOW);    
  }
  
  Serial.println("Started");
  display.setTextSize(3);
  display.setTextColor(WHITE);
  display.setCursor(0,0);
  display.setCursor(DP_WID_MID - (5 * CH_WID / 2),0);
  display.println("Start");
  display.display();
  display.setTextSize(3);
 }

bool which=1;
void nextLogo(){
  display.clearDisplay();
  if (which==0)  {display.drawBitmap(0,0,bnsflogo,128,32, 1);which=1;}
  else   {display.drawBitmap(0,0,cokelogo,128,32, 1);which=0;}
  display.display();

}

int wait_on(int side){
  int start=millis();
  int elapsed;
  Serial.println("Trigger");
  while (digitalRead(side)==cleared) {
    digitalWrite(10, digitalRead(7));
    digitalWrite(11, digitalRead(6));
    elapsed=millis()-start;
    if (elapsed > 10000) break; 
    display.clearDisplay();
    display.setCursor(DP_WID_MID - (6 * CH_WID / 2),0);
    display.print(elapsed); 
    display.println("ms"); 
    display.display();
    }
  Serial.println("Clear");
  Serial.print("Time=");Serial.println(elapsed,DEC);
  delay(500);
  doMPH(elapsed);
  delay(4500);
  display.clearDisplay();
  display.display();
  nextLogo();
  Serial.println("Waiting");
  return elapsed;
  }

void loop(){
  int k;
  int t;
  t=0;
  //Serial.println("Loop Start");
  digitalWrite(13,HIGH);
  digitalWrite(10, digitalRead(7));
  digitalWrite(11, digitalRead(6));
  if (digitalRead(6)==blocked and digitalRead(7)==cleared) t=wait_on(7);
  if (digitalRead(7)==blocked and digitalRead(6)==cleared) t=wait_on(6);
  digitalWrite(13,LOW);
}

